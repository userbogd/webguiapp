## Kconfig
```kconfig
menu "WebGuiApp configuration"
    config WEBGUIAPP_PROJECT_VER
        string "WebGUIApp Project version"
        default "0.0.0.0000"
        help
            Project version code          
    config WEBGUIAPP_HOSTNAME
    	string "Default host name"
    	default "DEVICE_HOSTNAME"
    	
    config WEBGUIAPP_USERNAME
    	string "Default user name"
    	default "user"	          
            
    config WEBGUIAPP_USERPASS
    	string "Default user password"
    	default "password"   

	menu "SPI settings"
		config WEBGUIAPP_SPI_ENABLE
		bool "Enabled SPI interface"
        default y
             help
        		Set enabled SPI bus
        
        if WEBGUIAPP_SPI_ENABLE	
			
			config SPI_HOST
	            int "SPI Host Number"
	            range 0 2
	            default 1
	            help
	                Set the SPI host used.
	
	        config SPI_SCLK_GPIO
	            int "SPI SCLK GPIO number"
	            range 0 33
	            default 18
	            help
	                Set the GPIO number used by SPI SCLK.
	
	        config SPI_MOSI_GPIO
	            int "SPI MOSI GPIO number"
	            range 0 33
	            default 23
	            help
	                Set the GPIO number used by SPI MOSI.
	
	        config SPI_MISO_GPIO
	            int "SPI MISO GPIO number"
	            range 0 33
	            default 19
	            help
	                Set the GPIO number used by SPI MISO.
	                
		endif
	endmenu

	menu "I2C settings"
		config WEBGUIAPP_I2C_ENABLE
		bool "Enabled I2C interface"
        default y
             help
        		Set enabled I2C bus
        
        if WEBGUIAPP_I2C_ENABLE	
			
			config I2C_HOST
	            int "I2C Host Number"
	            range 0 1
	            default 0
	            help
	                Set the I2C host used.  
	            
	        config I2C_SCL_GPIO
	            int "I2C SCL GPIO number"
	            range 0 34
	            default 22   
	            
	        config I2C_SDA_GPIO
	            int "I2C SDA GPIO number"
	            range 0 34
	            default 21   
	            
	        config I2C_CLOCK
	            int "I2C clock"
	            range 400000 1000000
	            default 400000
	            
		endif
	endmenu

 

    menu "WiFi settings"
		config WEBGUIAPP_WIFI_ENABLE
			bool "Enabled WIFI interface"
	        default y
	             help
	        		Set enabled WiFi
	        
	    if WEBGUIAPP_WIFI_ENABLE
	    	
	    	config WEBGUIAPP_WIFI_ON
				bool "Default WiFi switched on"
	        	default y
	    	
	    	config WEBGUIAPP_WIFI_DHCP_ON
				bool "Default WiFi DHCP switched on"
	        	default y
	    	
			config WEBGUIAPP_WIFI_SSID_AP
			    string "WiFi SSID AP"
			    default "YourAP"
			    help
					SSID (network name) in AP mode.
			
			config WEBGUIAPP_WIFI_KEY_AP
			    string "WiFi key AP"
			    default "123456789"
			    help
					WiFi key (WPA or WPA2) in AP mode.
					
			config WEBGUIAPP_WIFI_SSID_STA
			    string "WiFi SSID STA"
			    default "YourSTA"
			    help
					SSID (network name) in client mode.
			
			config WEBGUIAPP_WIFI_KEY_STA
			    string "WiFi key STA"
			    default "123456789"
			    help
					WiFi key (WPA or WPA2) in client mode.
						
			config WEBGUIAPP_WIFI_IP_AP
			    string "Default IP address in AP mode"
			    default "192.168.150.1"
			
			config WEBGUIAPP_WIFI_IP_STA
			    string "Default IP address in STA mode"
			    default "192.168.150.1"
			
			config WEBGUIAPP_WIFI_MASK_STA
			    string "Default network mask in STA mode"
			    default "255.255.255.0"    
			    
			config WEBGUIAPP_WIFI_GATEWAY_STA
			    string "Default gateway in STA mode"
			    default "192.168.150.1"    
			    
			     
		endif
	endmenu	



    menu "Ethernet settings"
		config WEBGUIAPP_ETHERNET_ENABLE
			bool "Enabled ETHERNET interface"
	        default n
	             help
	        		Set enabled Ethernet adapter
	        			            
	    if WEBGUIAPP_ETHERNET_ENABLE
	        
	        config WEBGUIAPP_ETHERNET_ON
				bool "Default Ethernet switched on"
	        	default y
	        
	        config WEBGUIAPP_ETH_IP_DEFAULT
			    string "Default IP address"
			    default "192.168.160.1"
			
			config WEBGUIAPP_ETH_MASK_DEFAULT
			    string "Default network mask"
			    default "255.255.255.0"    
			    
			config WEBGUIAPP_ETH_GATEWAY_DEFAULT
			    string "Default gateway"
			    default "192.168.160.1" 
			     
	        config WEBGUIAPP_ETHERNET_DHCP_DEFAULT
				bool "Default Ethernet DHCP client on"
	        	default n
	        	
			config GPIO_RANGE_MIN
		        int
		        default 0
		
		    config GPIO_RANGE_MAX
		        int
		        default 36 if IDF_TARGET_ESP32
		        default 46 if IDF_TARGET_ESP32S2
		        default 19 if IDF_TARGET_ESP32C3
		        default 48 if IDF_TARGET_ESP32S3
		
		    config USE_INTERNAL_ETHERNET
		        depends on IDF_TARGET_ESP32
		        select ETH_USE_ESP32_EMAC
		        bool "Internal EMAC"
		        help
		            Use internal Ethernet MAC controller.
		
		    if USE_INTERNAL_ETHERNET
		        choice ETH_PHY_MODEL
		            prompt "Ethernet PHY Device"
		            default ETH_PHY_IP101
		            help
		                Select the Ethernet PHY device to use in the example.
		
		            config ETH_PHY_IP101
		                bool "IP101"
		                help
		                    IP101 is a single port 10/100 MII/RMII/TP/Fiber Fast Ethernet Transceiver.
		                    Goto http://www.icplus.com.tw/pp-IP101G.html for more information about it.
		
		            config ETH_PHY_RTL8201
		                bool "RTL8201/SR8201"
		                help
		                    RTL8201F/SR8201F is a single port 10/100Mb Ethernet Transceiver with auto MDIX.
		                    Goto http://www.corechip-sz.com/productsview.asp?id=22 for more information about it.
		
		            config ETH_PHY_LAN87XX
		                bool "LAN87xx"
		                help
		                    Below chips are supported:
		                    LAN8710A LAN8720A LAN8740A/LAN8741ALAN8742A 
		
		            config ETH_PHY_DP83848
		                bool "DP83848"
		                help
		                    DP83848 is a single port 10/100Mb/s Ethernet Physical Layer Transceiver.
		                    Goto http://www.ti.com/product/DP83848J for more information about it.
		
		            config ETH_PHY_KSZ8041
		                bool "KSZ8041"
		                help
		                    The KSZ8041 is a single supply 10Base-T/100Base-TX Physical Layer Transceiver.
		                    Goto https://www.microchip.com/wwwproducts/en/KSZ8041 for more information about it.
		
		            config ETH_PHY_KSZ8081
		                bool "KSZ8081"
		                help
		                    The KSZ8081 is a single supply 10Base-T/100Base-TX Physical Layer Transceiver.
		                    Goto https://www.microchip.com/wwwproducts/en/KSZ8081 for more information about it.
		        endchoice # EXAMPLE_ETH_PHY_MODEL
		
		        config ETH_MDC_GPIO
		            int "SMI MDC GPIO number"
		            range GPIO_RANGE_MIN GPIO_RANGE_MAX
		            default 23
		            help
		                Set the GPIO number used by SMI MDC.
		
		        config ETH_MDIO_GPIO
		            int "SMI MDIO GPIO number"
		            range GPIO_RANGE_MIN GPIO_RANGE_MAX
		            default 18
		            help
		                Set the GPIO number used by SMI MDIO.
		
		        config ETH_PHY_RST_GPIO
		            int "PHY Reset GPIO number"
		            range -1 GPIO_RANGE_MAX
		            default 5
		            help
		                Set the GPIO number used to reset PHY chip.
		                Set to -1 to disable PHY chip hardware reset.
		
		        config ETH_PHY_ADDR
		            int "PHY Address"
		            range 0 31
		            default 1
		            help
		                Set PHY address according your board schematic.
		    endif # USE_INTERNAL_ETHERNET
		
		    config USE_SPI_ETHERNET
		        bool "SPI Ethernet"
		        default y
		        select WEBGUIAPP_SPI_ENABLE
		        help
		            Use external SPI-Ethernet module(s).
		
		    if USE_SPI_ETHERNET
		        config SPI_ETHERNETS_NUM
		            int "Number of SPI Ethernet modules to use at a time"
		            range 1 2
		            default 1
		            help
		                Set the number of SPI Ethernet modules you want to use at a time. Multiple SPI modules can be connected
		                to one SPI interface and can be separately accessed based on state of associated Chip Select (CS).
		
		        choice ETHERNET_TYPE_SPI
		            prompt "Ethernet SPI"
		            default W5500
		            help
		                Select which kind of Ethernet will be used in the example.
		
		            config DM9051
		                bool "DM9051 Module"
		                select ETH_SPI_ETHERNET_DM9051
		                help
		                    Select external SPI-Ethernet module (DM9051).
		
		            config KSZ8851SNL
		                bool "KSZ8851SNL Module"
		                select ETH_SPI_ETHERNET_KSZ8851SNL
		                help
		                    Select external SPI-Ethernet module (KSZ8851SNL).
		
		            config W5500
		                bool "W5500 Module"
		                select ETH_SPI_ETHERNET_W5500
		                help
		                    Select external SPI-Ethernet module (W5500).
		        endchoice
		
		
		        config ETH_SPI_CLOCK_MHZ
		            int "SPI clock speed (MHz)"
		            range 5 80
		            default 12 if IDF_TARGET_ESP32 || IDF_TARGET_ESP32C3
		            default 36 if IDF_TARGET_ESP32S2 || IDF_TARGET_ESP32S3
		            help
		                Set the clock speed (MHz) of SPI interface.
		
		        config ETH_SPI_CS0_GPIO
		            int "SPI CS0 GPIO number for SPI Ethernet module #1"
		            range GPIO_RANGE_MIN GPIO_RANGE_MAX
		            default 15 if IDF_TARGET_ESP32
		            default 10 if IDF_TARGET_ESP32S2 || IDF_TARGET_ESP32C3 || IDF_TARGET_ESP32S3
		            help
		                Set the GPIO number used by SPI CS0, i.e. Chip Select associated with the first SPI Eth module).
		
		        config ETH_SPI_CS1_GPIO
		            depends on SPI_ETHERNETS_NUM > 1
		            int "SPI CS1 GPIO number for SPI Ethernet module #2"
		            range GPIO_RANGE_MIN GPIO_RANGE_MAX
		            default 32 if IDF_TARGET_ESP32
		            default 7 if IDF_TARGET_ESP32S2 || IDF_TARGET_ESP32S3
		            default 8 if IDF_TARGET_ESP32C3
		            help
		                Set the GPIO number used by SPI CS1, i.e. Chip Select associated with the second SPI Eth module.
		
		        config ETH_SPI_INT0_GPIO
		            int "Interrupt GPIO number SPI Ethernet module #1"
		            range 0 39
		            default 4 if IDF_TARGET_ESP32 || IDF_TARGET_ESP32S2 || IDF_TARGET_ESP32C3 || IDF_TARGET_ESP32S3
		            help
		                Set the GPIO number used by the first SPI Ethernet module interrupt line.
		
		        config ETH_SPI_INT1_GPIO
		            depends on SPI_ETHERNETS_NUM > 1
		            int "Interrupt GPIO number SPI Ethernet module #2"
		            range 0 36
		            default 33 if IDF_TARGET_ESP32
		            default 5 if IDF_TARGET_ESP32S2 || IDF_TARGET_ESP32C3 || IDF_TARGET_ESP32S3
		            help
		                Set the GPIO number used by the second SPI Ethernet module interrupt line.
		
		        config ETH_SPI_PHY_RST0_GPIO
		            int "PHY Reset GPIO number of SPI Ethernet Module #1"
		            range -1 GPIO_RANGE_MAX
		            default -1
		            help
		                Set the GPIO number used to reset PHY chip on the first SPI Ethernet module.
		                Set to -1 to disable PHY chip hardware reset.
		
		        config ETH_SPI_PHY_RST1_GPIO
		            depends on SPI_ETHERNETS_NUM > 1
		            int "PHY Reset GPIO number of SPI Ethernet Module #2"
		            range -1 GPIO_RANGE_MAX
		            default -1
		            help
		                Set the GPIO number used to reset PHY chip on the second SPI Ethernet module.
		                Set to -1 to disable PHY chip hardware reset.
		
		        config ETH_SPI_PHY_ADDR0
		            int "PHY Address of SPI Ethernet Module #1"
		            range 0 31
		            default 1
		            help
		                Set the first SPI Ethernet module PHY address according your board schematic.
		
		        config ETH_SPI_PHY_ADDR1
		            depends on SPI_ETHERNETS_NUM > 1
		            int "PHY Address of SPI Ethernet Module #2"
		            range 0 31
		            default 1
		            help
		                Set the second SPI Ethernet module PHY address according your board schematic.
		    endif # USE_SPI_ETHERNET    	
	    endif
	endmenu	



     menu "GPRS settings"
			config WEBGUIAPP_GPRS_ENABLE
				bool "Enabled GPRS PPP interface"
	        	default n
	             	help
	        			Set enabled GPRS adapter
	        				            
	   	if WEBGUIAPP_GPRS_ENABLE
	        
	        config WEBGUIAPP_GPRS_ON
				bool "Default GPRS switched on"
	        	default n
	        	
	   		choice MODEM_DEVICE
	            prompt "Choose supported modem device (DCE)"
	            default MODEM_DEVICE_SIM800
	            help
	                Select modem device connected to the ESP DTE.
	            config MODEM_DEVICE_SIM800
	                bool "SIM800"
	                help
	                    SIMCom SIM800L is a GSM/GPRS module.
	                    It supports Quad-band 850/900/1800/1900MHz.
	            config MODEM_DEVICE_BG96
	                bool "BG96"
	                help
	                    Quectel BG96 is a series of LTE Cat M1/Cat NB1/EGPRS module.
	            config MODEM_DEVICE_SIM7600
	                bool "SIM7600"
	                help
	                    SIM7600 is Multi-Band LTE-TDD/LTE-FDD/HSPA+ and GSM/GPRS/EDGE module
            endchoice 
            
            config MODEM_PPP_APN
	            string "Set MODEM APN"
	            default "internet"
	            help
	                Set APN (Access Point Name), a logical name to choose data network
    
	        config MODEM_PPP_AUTH_USERNAME
	            string "Set username for authentication"
	            default "gdata"
	            depends on !MODEM_PPP_AUTH_NONE
	            help
	                Set username for PPP Authentication.
	    
	        config MODEM_PPP_AUTH_PASSWORD
	            string "Set password for authentication"
	            default "gdata"
	            depends on !MODEM_PPP_AUTH_NONE
	            help
	                Set password for PPP Authentication.
	    
	        config MODEM_PPP_AUTH_NONE
	            bool "Skip PPP authentication"
	            default n
	            help
	                Set to true for the PPP client to skip authentication
	    
	    
	        config MODEM_NEED_SIM_PIN
	            bool "SIM PIN needed"
	            default n
	            help
	                Enable to set SIM PIN before starting the example
	    
	        config MODEM_SIM_PIN
	            string "Set SIM PIN"
	            default "1234"
	            depends on MODEM_NEED_SIM_PIN
	            help
	                Pin to unlock the SIM
	    
	        menu "UART Configuration"
	            config MODEM_UART_TX_PIN
	                int "TXD Pin Number"
	                default 17
	                range 0 31
	                help
	                    Pin number of UART TX.
	    
	            config MODEM_UART_RX_PIN
	                int "RXD Pin Number"
	                default 16
	                range 0 31
	                help
	                    Pin number of UART RX.
	    
	            config MODEM_UART_RTS_PIN
	                int "RTS Pin Number"
	                default 0
	                range 0 31
	                help
	                    Pin number of UART RTS.
	    
	            config MODEM_UART_CTS_PIN
	                int "CTS Pin Number"
	                default 0
	                range 0 31
	                help
	                    Pin number of UART CTS.
	    
	            config MODEM_UART_EVENT_TASK_STACK_SIZE
	                int "UART Event Task Stack Size"
	                range 2000 6000
	                default 2048
	                help
	                    Stack size of UART event task.
	    
	            config MODEM_UART_EVENT_TASK_PRIORITY
	                int "UART Event Task Priority"
	                range 3 22
	                default 5
	                help
	                    Priority of UART event task.
	    
	            config MODEM_UART_EVENT_QUEUE_SIZE
	                int "UART Event Queue Size"
	                range 10 40
	                default 30
	                help
	                    Length of UART event queue.
	    
	            config MODEM_UART_PATTERN_QUEUE_SIZE
	                int "UART Pattern Queue Size"
	                range 10 40
	                default 20
	                help
	                    Length of UART pattern queue.
	    
	            config MODEM_UART_TX_BUFFER_SIZE
	                int "UART TX Buffer Size"
	                range 256 2048
	                default 512
	                help
	                    Buffer size of UART TX buffer.
	    
	            config MODEM_UART_RX_BUFFER_SIZE
	                int "UART RX Buffer Size"
	                range 256 2048
	                default 1024
	                help
	                    Buffer size of UART RX buffer.
	        endmenu
             	    
	    endif
    endmenu

	menu "MQTT settings"
		config WEBGUIAPP_MQTT_ENABLE
			bool "Enabled MQTT transport"
	        default y

	   	if WEBGUIAPP_MQTT_ENABLE
	   		config WEBGUIAPP_MQTT_CLIENTS_NUM
	        	int "Number of MQTT clients"
	            range 1 2
	            default 2
	    
	    	config WEBGUIAPP_MQTT_ON
	    		bool "Enable MQTT client"
	    		default y
	    		
	    	config WEBGUIAPP_MQTT_MAX_TOPIC_LENGTH
	    		int "Max topic length"
	    		range 32 512
	    		default 64		
	    		
	    	config WEBGUIAPP_MQTT_SERVER_URL
	    		string "MQTT server URL"
	    		default "myfirstmqttserver.com"
	    	
	    	config WEBGUIAPP_MQTT_SERVER_PORT
	    		int "MQTT server port"
	    		range 1 65535
	    		default 1883
	    	
	    	config WEBGUIAPP_MQTT_CLIENT_ID_1
	    		string "MQTT_1 client ID"
	    		default "DEVID1"	
	    	
	    	if WEBGUIAPP_MQTT_CLIENTS_NUM > 1
	    		config WEBGUIAPP_MQTT_CLIENT_ID_2
	    			string "MQTT_2 client ID"
	    			default "DEVID2"
	    	endif	
	    		
	    	config WEBGUIAPP_MQTT_ROOT_TOPIC
	    		string "MQTT root topic"
	    		default "ROOTTOPIC"
	    	
	    	config WEBGUIAPP_MQTT_USERNAME
	    		string "MQTT user name"
	    		default "username"
	    	
	    	config WEBGUIAPP_MQTT_PASSWORD
	    		string "MQTT user password"
	    		default "password"			 			        
	   	
	   	endif
	endmenu
	
	if 	WEBGUIAPP_WIFI_ENABLE || WEBGUIAPP_ETHERNET_ENABLE || WEBGUIAPP_GPRS_ENABLE
		menu "DNS settings"
		
			config WEBGUIAPP_DNS1_ADDRESS_DEFAULT
			string "DNS1"
			default "8.8.8.8"
			
			config WEBGUIAPP_DNS2_ADDRESS_DEFAULT
			string "DNS2"
			default "8.8.4.4"
			
			config WEBGUIAPP_DNS3_ADDRESS_DEFAULT
			string "DNS3"
			default "1.1.1.1"
			
		endmenu
	endif
                           
endmenu
```
